## conf/layer.conf
```bitbake
# We have a conf and classes directory, add to BBPATH
BBPATH .= ":${LAYERDIR}"

# We have recipes-* directories, add to BBFILES
BBFILES += "${LAYERDIR}/recipes-*/*/*.bb \
            ${LAYERDIR}/recipes-*/*/*.bbappend"

BBFILE_COLLECTIONS += "meta-python-cloudcycle"
BBFILE_PATTERN_meta-python-cloudcycle = "^${LAYERDIR}/"
BBFILE_PRIORITY_meta-python-cloudcycle = "20"

LAYERDEPENDS_meta-python-cloudcycle = "core"
LAYERSERIES_COMPAT_meta-python-cloudcycle = "dunfell"
```
